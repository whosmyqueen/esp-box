## examples/chatgpt_demo/factory_nvs/main/Kconfig.projbuild
```kconfig
menu "Example Configuration"

    config ESP_WIFI_SSID
        string "WiFi SSID"
        default "AIGCC-WIFII"
        help
            SSID (network name) for the example to connect to.
    config ESP_WIFI_PASSWORD
        string "WiFi Password"
        default "aigc2024@sensetime.com"
        help
            WiFi password (WPA or WPA2) for the example to use.
    config OPENAI_API_KEY
        string "OpenAI Key"
        default "sk-xxxxxxxx"
        help
            OpenAI api key for the example to use.
    config OPENAI_URL
        string "Base URL"
        default "https://api.openai.com/v1/"
        help
            Base URL for OpenAI API
    config REALTIME_URL
        string "Realtime URL"
        default "https://rtc.senseflow-test.sensetime.com/"
        help
            Realtime URL for Senseflow API
    config SENSEFLOW_KEY
        string "Senseflow Key"
        default "app-2N0KwAz2KEO1tc0e2ElxGbPl"
        help
            Senseflow api key for the example to use.
endmenu
```
